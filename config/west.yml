## config/west.yml
```yaml
manifest:
  remotes:
    - name: zmkfirmware
      url-base: https://github.com/zmkfirmware

  projects:
    - name: eyelash_corne
      url: https://github.com/a741725193/zmk-new_corne
      revision: main

    - name: zmk
      remote: zmkfirmware
      revision: main
      import: app/west.yml

    - name: zmk-unicode
      url: https://github.com/urob/zmk-unicode.git
      revision: main
      path: modules/zmk-unicode

  self:
    path: config
```
